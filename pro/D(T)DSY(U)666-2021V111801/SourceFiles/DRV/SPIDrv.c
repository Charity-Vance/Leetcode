/*******************************************************************************************************
**** Copyright：  (c)Copyright 2019,浙江正泰仪器仪表有限责任公司,电能表应用研发                       
****                            All rights reserved.                                                 
**** FileName:    SPIDrv.c                                                                          
**** Brief:       SPI通信接口驱动文件                                                                      
**** Author:      peter.he@chint.com                                                                 
**** Version:     V1.0                                                                               
**** Date:        2016-7-14                                                                          
****                                                                                                 
**** note:修改历史记录列表，每条修改记录应包括修改日期、修改者                                          
**** 1.  Author:                                                                                     
****     Version:                                                                                    
****     Date :                                                                                      
**** 2.  Author:                                                                                     
****     Version:                                                                                       
****     Date:
****                                                                                        
****  addtogroup:Library                                                             
**********************************************************************************************************/

/*--------------------------------- 文件功能说明 -------------------------------------------------------*/
/*
 *  该文件所有函数的前缀为xxxx_
 *  文件主函数和对外函数需放在文件的首部，并且主函数需要放在第一个位置;
 *  函数注释采用标准模板，函数内部注释采用//;
 *  对于注释较多的部分，可以增加一个注释符，然后详细说明放在文件的尾部;
 *--------------------------------- 文件功能说明 -------------------------------------------------------*/
 
/**有形参的函数格式:*/
/*------------------------------------------------------------------------------------------------------*/
/**
 *  @brief    xx任务处理函数
 *
 *  @param    xx :
 *
 *  @return   xx
 *
 *  @note     xx
 *
 */
/*------------------------------------------------------------------------------------------------------*/
/**无形参的函数格式:*/
/*------------------------------------------------------------------------------------------------------*/
/**
 *  @brief    上电所有口线配置成初始状态，后面可根据需要开启和配置
 *
 *  @return   xx
 *
 *  @note     xx
 *
 */
/*------------------------------------------------------------------------------------------------------*/
 
 

/*----------------< 包含文件 >----------------------------------*/
#include "..\SourceFiles\PUB\Include.h"

#if ( METER_TYPE == METER_TYPE_DTSY666)

/*----------------< 宏定义区 >----------------------------------*/

/*----------------< 常量定义 >----------------------------------*/


/*----------------< 变量定义 >----------------------------------*/


/*----------------< 函数声明 >----------------------------------*/
uchar8 SPIDrv_ReceiveByte(void);
void SPIDrv_SendBtye ( uchar8 v_ucSendData );
void SPIDrv_ENSPIMode(void);
void SPIDrv_Eable_MeterIC(void);
void SPIDrv_Disable_MeterIC(void);
/*----------------< 函数定义 >----------------------------------*/


/*------------------------------------------------------------------------------------------------------*/
/**
 *  @brief    从spi口线上读取一个字节的响应数据
 *
 *  @return   V_ucTempData:读取到的数据
 *
 *  @note     如果读不到数据，也会返回数据
 *
 */
/*------------------------------------------------------------------------------------------------------*/
 
uchar8 SPIDrv_ReceiveByte(void)
{
	uchar8 i,V_ucDataTemp;
	SPI_DIN_In();
	V_ucDataTemp=0;
	SPI_CLK_L();
	for(i=0;i<8;i++)
	{
		V_ucDataTemp = V_ucDataTemp<<1;
		SPI_CLK_H();
		LibPub_Delay2us();
		if( SPI_DIN_Status_HIGHT )
		{
			V_ucDataTemp |= 0x01;
		}
		SPI_CLK_L();
		LibPub_Delay2us();
		NOP();
		NOP();
    }
	SPI_CLK_L();;
	return V_ucDataTemp;
}

/*------------------------------------------------------------------------------------------------------*/
/**
 *  @brief    向SPI总线上发送1字节的数据
 *
 *  @param    v_ucSendData :待写入的数据
 *
 *  @return   xx
 *
 *  @note     xx
 *
 */
/*------------------------------------------------------------------------------------------------------*/
void SPIDrv_SendBtye ( uchar8 v_ucSendData )
{
	uchar8 i;
	SPI_DIN_In(); 
    SPI_CLK_L();
	for(i=0;i<8;i++)
	{
		SPI_CLK_H();
		if( (v_ucSendData&0x80)!= 0)
		{
			SPI_DOUT_H();
		}
		else
		{
			SPI_DOUT_L();
		}
		LibPub_Delay2us();
		SPI_CLK_L();
		v_ucSendData = v_ucSendData<<1;
		LibPub_Delay2us();
		NOP();
		NOP();
	}
	SPI_CLK_L();
}

///*****************************************************************************************///
///*函数原型：void SPIDrv_ENSPIMode(void)
///*功能描述：使能计量芯片SPI总线
///*输入参数：无
///*输出参数：无
///*返回参数：无
///*功能说明：通过控制CS口线控制计量芯片
///*调用机制：
///*备    注：
///*****************************************************************************************///
void SPIDrv_ENSPIMode(void)
{
	SPI_DIN_In(); 
	SPI_CLK_H();
	LibPub_Delay2us();
	SPI_CS_L();
	LibPub_Delay2us();
	SPI_CS_H();
	LibPub_Delay2us();
	SPI_CS_L();
}

///*****************************************************************************************///
///*函数原型：void SPIDrv_Eable_MeterIC(void)
///*功能描述：使能计量芯片
///*输入参数：无
///*输出参数：无
///*返回参数：无
///*功能说明：拉低CS脚，使能计量芯片
///*调用机制：
///*备    注：
///*****************************************************************************************///
void SPIDrv_Eable_MeterIC(void)
{
	SPI_CS_H(); 
	LibPub_Delay2us();   
	SPI_CLK_L(); 
	LibPub_Delay2us();
	SPI_CS_L();
	LibPub_Delay2us();
	LibPub_Delay2us();
}
///*****************************************************************************************///
///*函数原型：void SPIDrv_Disable_MeterIC(void)
///*功能描述：失能计量芯片
///*输入参数：无
///*输出参数：无
///*返回参数：无
///*功能说明：置高CS脚，失能计量芯片
///*调用机制：
///*备    注：
///*****************************************************************************************///
void SPIDrv_Disable_MeterIC(void)
{
	SPI_CS_H();
	LibPub_Delay2us();
}

#endif


